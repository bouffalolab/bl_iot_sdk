## components/3rdparty/hwcloud_iot_link/iot_link/Kconfig
```kconfig
#
# Copyright (c) [2020] Huawei Technologies Co.,Ltd.All rights reserved.
#
# LiteOS NOVA is licensed under the Mulan PSL v1.
# You can use this software according to the terms and conditions of the Mulan PSL v1.
# You may obtain a copy of Mulan PSL v1 at:
#
#   http://license.coscl.org.cn/MulanPSL
#
# THIS SOFTWARE IS PROVIDED ON AN "AS IS" BASIS, WITHOUT WARRANTIES OF ANY KIND, EITHER
# EXPRESS OR IMPLIED, INCLUDING BUT NOT LIMITED TO NON-INFRINGEMENT, MERCHANTABILITY OR
# FIT FOR A PARTICULAR PURPOSE.
# See the Mulan PSL v1 for more details.
#

menu "IoT link SDK configuration"
comment "you should choose a os kernel first!"

rsource "./os/Kconfig"   
rsource "./at/Kconfig"
config CJSON_ENABLE
    bool "Enable cJson library."
    default y
    
config DRIVER_ENABLE
    bool "Enable IoT Link driver management."
    default y
    depends on LITEOS_ENABLE || NOVAOS_ENABLE || NEW_OS
        
rsource "./link_log/Kconfig"    

    
config LINKQUEUE_ENABLE
    bool  "Enable IoT Link Queue"
    default y

config LINKDEMO_ENABLE
    bool  "Enable IoT Link Demo"
    default y    
            
rsource "./stimer/Kconfig"

rsource "./link_ota/Kconfig"

rsource "./network/Kconfig"

rsource "./oc/Kconfig"

rsource "./shell/Kconfig"    
     
config IOT_LINK_CONFIGFILE
    string "The specified Configuration Header"
    default "iot_config.h"
   
endmenu
```

## components/3rdparty/hwcloud_iot_link/iot_link/at/Kconfig
```kconfig
#
# Copyright (c) [2020] Huawei Technologies Co.,Ltd.All rights reserved.
#
# LiteOS NOVA is licensed under the Mulan PSL v1.
# You can use this software according to the terms and conditions of the Mulan PSL v1.
# You may obtain a copy of Mulan PSL v1 at:
#
#   http://license.coscl.org.cn/MulanPSL
#
# THIS SOFTWARE IS PROVIDED ON AN "AS IS" BASIS, WITHOUT WARRANTIES OF ANY KIND, EITHER
# EXPRESS OR IMPLIED, INCLUDING BUT NOT LIMITED TO NON-INFRINGEMENT, MERCHANTABILITY OR
# FIT FOR A PARTICULAR PURPOSE.
# See the Mulan PSL v1 for more details.
#
menu "At configuration"
    depends on LITEOS_ENABLE || NOVAOS_ENABLE || NEW_OS

config AT_ENABLE
    bool "Enable AT framework. and we will select the driver"
    select DRIVER_ENABLE
    default y

if AT_ENABLE

    config AT_DEVNAME 
        string "The device for the at io"
        default "atdev"
    
    config AT_OOBTABLEN
        int "How many oob functions could be hooked"
        default 6
        
    config AT_RECVMAXLEN
        int "The maxlen could be received for the at components"
        default 1024
        
    config AT_TASKPRIOR
        int "The at receive task priority"
        default 10     
endif

endmenu
```

## components/3rdparty/hwcloud_iot_link/iot_link/link_ota/Kconfig
```kconfig
#
# Copyright (c) [2020] Huawei Technologies Co.,Ltd.All rights reserved.
#
# LiteOS NOVA is licensed under the Mulan PSL v1.
# You can use this software according to the terms and conditions of the Mulan PSL v1.
# You may obtain a copy of Mulan PSL v1 at:
#
#   http://license.coscl.org.cn/MulanPSL
#
# THIS SOFTWARE IS PROVIDED ON AN "AS IS" BASIS, WITHOUT WARRANTIES OF ANY KIND, EITHER
# EXPRESS OR IMPLIED, INCLUDING BUT NOT LIMITED TO NON-INFRINGEMENT, MERCHANTABILITY OR
# FIT FOR A PARTICULAR PURPOSE.
# See the Mulan PSL v1 for more details.
#

menu "OTA"

#OTA_ENABLE ONLY ENABLE THE IMG COMPONENTS, AND  THIS NEEDED BY THE FOTA OR SOTA DOWNLOAD RPOCESS
config OTA_ENABLE
    bool  "Enable the Link OTA"
    default y

if OTA_ENABLE
    config OTA_VERSIONLEN
        int  "Version string length"
        default 32
#OTA_PATCH, SUPPLY THE METHOD DO THE BACKUP UPGRADE RECOVER
    config OTA_PATCH
        bool "Enable the img patch"
        default n        
endif    
                 
endmenu
```

## components/3rdparty/hwcloud_iot_link/iot_link/network/coap/Kconfig
```kconfig
#
# Copyright (c) [2020] Huawei Technologies Co.,Ltd.All rights reserved.
#
# LiteOS NOVA is licensed under the Mulan PSL v1.
# You can use this software according to the terms and conditions of the Mulan PSL v1.
# You may obtain a copy of Mulan PSL v1 at:
#
#   http://license.coscl.org.cn/MulanPSL
#
# THIS SOFTWARE IS PROVIDED ON AN "AS IS" BASIS, WITHOUT WARRANTIES OF ANY KIND, EITHER
# EXPRESS OR IMPLIED, INCLUDING BUT NOT LIMITED TO NON-INFRINGEMENT, MERCHANTABILITY OR
# FIT FOR A PARTICULAR PURPOSE.
# See the Mulan PSL v1 for more details.
#

menu "Coap  configuration"

config COAP_AL_ENABLE
    bool "Enable the coap abstract layer"
    default n

if COAP_AL_ENABLE
    choice
        prompt "please select one coap implement"   
        config LITECOAP_ENABLE
            bool "we use the litecoap as the coap protocol"
        
        config LIBCOAP_ENABLE
            bool "we use the libcoap as the coap protocol"
                  
        config COAP_NEWENABLE
            bool "Create a New Coap"                
    endchoice
endif
endmenu
```

## components/3rdparty/hwcloud_iot_link/iot_link/network/dtls/Kconfig
```kconfig
#
# Copyright (c) [2020] Huawei Technologies Co.,Ltd.All rights reserved.
#
# LiteOS NOVA is licensed under the Mulan PSL v1.
# You can use this software according to the terms and conditions of the Mulan PSL v1.
# You may obtain a copy of Mulan PSL v1 at:
#
#   http://license.coscl.org.cn/MulanPSL
#
# THIS SOFTWARE IS PROVIDED ON AN "AS IS" BASIS, WITHOUT WARRANTIES OF ANY KIND, EITHER
# EXPRESS OR IMPLIED, INCLUDING BUT NOT LIMITED TO NON-INFRINGEMENT, MERCHANTABILITY OR
# FIT FOR A PARTICULAR PURPOSE.
# See the Mulan PSL v1 for more details.
#


menu "Dtls  configuration"

config DTLS_AL_ENABLE
    bool "enable the dtls abstract layer"
    default y
    
if DTLS_AL_ENABLE
    choice
    prompt "please select one dtls implement"
    config MBEDTLS_ENABLE
        bool  "select mbedtls(polar ssl) as the (d)tls"
            
    config OPENSSL_ENABLE
        bool  "select openssl as the (d)tls"
        
    config NEWTLS_ENABLE
        bool  "select the unknown one, and you should implement it"
    endchoice 
    
    if MBEDTLS_ENABLE   
        rsource "./mbedtls/kconfig_mbedtls"
    endif
                 
endif

endmenu
```

## components/3rdparty/hwcloud_iot_link/iot_link/network/lwm2m/Kconfig
```kconfig
#
# Copyright (c) [2020] Huawei Technologies Co.,Ltd.All rights reserved.
#
# LiteOS NOVA is licensed under the Mulan PSL v1.
# You can use this software according to the terms and conditions of the Mulan PSL v1.
# You may obtain a copy of Mulan PSL v1 at:
#
#   http://license.coscl.org.cn/MulanPSL
#
# THIS SOFTWARE IS PROVIDED ON AN "AS IS" BASIS, WITHOUT WARRANTIES OF ANY KIND, EITHER
# EXPRESS OR IMPLIED, INCLUDING BUT NOT LIMITED TO NON-INFRINGEMENT, MERCHANTABILITY OR
# FIT FOR A PARTICULAR PURPOSE.
# See the Mulan PSL v1 for more details.
#

menu "Lwm2m configuration"

config LWM2M_AL_ENABLE
    bool "Enable the lwm2m abstract layer"
    default n

if LWM2M_AL_ENABLE

choice
 
    prompt "please select one lwm2m implement; if you have your self, please select lwm2m_new"
    
    config WAKAAMALWM2M_ENABLE
        bool "we use the wakaama(the modified version) as the lwm2m protocol"
        select MBEDTLS_PSK
    
    config WAKAAMARAW_ENABLE
        bool "we use the wakaama(the unmodified version) as the lwm2m protocol"
        select MBEDTLS_PSK
                   
    config COAP_NEW
        bool "we will create a new lwm2m ourself"    
           
    endchoice
               
endif   
    
endmenu
```

## components/3rdparty/hwcloud_iot_link/iot_link/network/mqtt/Kconfig
```kconfig
#
# Copyright (c) [2020] Huawei Technologies Co.,Ltd.All rights reserved.
#
# LiteOS NOVA is licensed under the Mulan PSL v1.
# You can use this software according to the terms and conditions of the Mulan PSL v1.
# You may obtain a copy of Mulan PSL v1 at:
#
#   http://license.coscl.org.cn/MulanPSL
#
# THIS SOFTWARE IS PROVIDED ON AN "AS IS" BASIS, WITHOUT WARRANTIES OF ANY KIND, EITHER
# EXPRESS OR IMPLIED, INCLUDING BUT NOT LIMITED TO NON-INFRINGEMENT, MERCHANTABILITY OR
# FIT FOR A PARTICULAR PURPOSE.
# See the Mulan PSL v1 for more details.
#

menu "Mqtt  configuration"

config MQTT_AL_ENABLE
    bool "Enable the mqtt abstract layer"
    default y

if MQTT_AL_ENABLE
choice
 
    prompt "please select one mqtt implement; if you have your self, please select mqtt_new"
    
    config PAHO_MQTT
        bool "we use paho mqtt as the mqtt protocol"
        select MBEDTLS_CERT
    
    config LITE_MQTT
        bool "we use the lite mqtt as the mqtt protocol"
        select MBEDTLS_CERT       
             
    config NEW_MQTT
        bool "we will create a new mqtt ourself"    
           
    endchoice
    
    if PAHO_MQTT
        rsource "./paho_mqtt/kconfig_paho"
    endif
    
               
endif   
    
endmenu
```

## components/3rdparty/hwcloud_iot_link/iot_link/network/tcpip/Kconfig
```kconfig
#
# Copyright (c) [2020] Huawei Technologies Co.,Ltd.All rights reserved.
#
# LiteOS NOVA is licensed under the Mulan PSL v1.
# You can use this software according to the terms and conditions of the Mulan PSL v1.
# You may obtain a copy of Mulan PSL v1 at:
#
#   http://license.coscl.org.cn/MulanPSL
#
# THIS SOFTWARE IS PROVIDED ON AN "AS IS" BASIS, WITHOUT WARRANTIES OF ANY KIND, EITHER
# EXPRESS OR IMPLIED, INCLUDING BUT NOT LIMITED TO NON-INFRINGEMENT, MERCHANTABILITY OR
# FIT FOR A PARTICULAR PURPOSE.
# See the Mulan PSL v1 for more details.
#

menu "Tcpip configuration"

config TCIP_AL_ENABLE
    bool "Enable the tcpip abstract layer"
    default y

if TCIP_AL_ENABLE

choice 
    prompt "please select one tcpip implement; if you have your self, please select none"
    
    config LWIP_ENABLE
        bool "lwip is for the tcpip"
    
    config RTK8710_ENABLE
        bool "we use RTK8710, and will select the at components"
        select AT_ENABLE
            
    config ESP8266_ENABLE
        bool  "we use esp8266, and will select the at components"    
        select AT_ENABLE
          
    config MACOSSOCKET_ENABLE
        bool "we use the macos socket ,and select the macos"
        select MACOS_ENABLE
               
    config LINUXSOCKET_ENABLE
        bool "we use the linux socket ,and will select the linux"
        select LINUXOS_ENABLE
             
    config NEW_SOCKET
        bool "we will create a new tcpip ourself"    
           
    endchoice
    
    if ESP8266_ENABLE
       rsource "./esp8266_socket/kconfig_esp8266"        
    endif
           
endif   
    
endmenu
```

## components/3rdparty/hwcloud_iot_link/iot_link/oc/Kconfig
```kconfig
#
# Copyright (c) [2020] Huawei Technologies Co.,Ltd.All rights reserved.
#
# LiteOS NOVA is licensed under the Mulan PSL v1.
# You can use this software according to the terms and conditions of the Mulan PSL v1.
# You may obtain a copy of Mulan PSL v1 at:
#
#   http://license.coscl.org.cn/MulanPSL
#
# THIS SOFTWARE IS PROVIDED ON AN "AS IS" BASIS, WITHOUT WARRANTIES OF ANY KIND, EITHER
# EXPRESS OR IMPLIED, INCLUDING BUT NOT LIMITED TO NON-INFRINGEMENT, MERCHANTABILITY OR
# FIT FOR A PARTICULAR PURPOSE.
# See the Mulan PSL v1 for more details.
#


menu "OceanConnect SERVICE configuration" 

config OCSERVICES_ENABLE
    bool  "Enable the oc service, like the mqtt/coap/lwm2m to communicate with the oc platform"
    default y

if OCSERVICES_ENABLE
    rsource "./oc_coap/kconfig_occoap"
    
    rsource "./oc_lwm2m/kconfig_oclwm2m"
            
    rsource "./oc_mqtt/Kconfig"

endif      
         
endmenu
```

## components/3rdparty/hwcloud_iot_link/iot_link/oc/oc_mqtt/Kconfig
```kconfig
#
# Copyright (c) [2020] Huawei Technologies Co.,Ltd.All rights reserved.
#
# LiteOS NOVA is licensed under the Mulan PSL v1.
# You can use this software according to the terms and conditions of the Mulan PSL v1.
# You may obtain a copy of Mulan PSL v1 at:
#
#   http://license.coscl.org.cn/MulanPSL
#
# THIS SOFTWARE IS PROVIDED ON AN "AS IS" BASIS, WITHOUT WARRANTIES OF ANY KIND, EITHER
# EXPRESS OR IMPLIED, INCLUDING BUT NOT LIMITED TO NON-INFRINGEMENT, MERCHANTABILITY OR
# FIT FOR A PARTICULAR PURPOSE.
# See the Mulan PSL v1 for more details.
#

menu "OceanConnect Mqtt configuration"

config OCMQTT_ENABLE
    bool "Enable the ocmqtt abstract layer"
    default y
    

if  OCMQTT_ENABLE
    config OCMQTT_ATCMD
        bool  "Enable the OCMQTT AT COMMAND API"
        default y
        
    config OCMQTT_OTA
        bool  "Enable the OCMQTT  OTA"
        default y    
        select OTA_ENABLE
    
    config OCMQTT_DEMOENABLE
        bool "Enable the OCMQTT STANDARD DEMO"
        default n
        
    
    choice
    prompt "Please select the interface type"
     
    config OC_MQTT_V5
        bool "Enable the V5 interface with DMP"
    config OC_MQTT_V1     
        bool "Enable the V1 interface with DMP"
    
    endchoice

    choice
    prompt "please select one oc mqtt implement"
    
    if OC_MQTT_V1
        config OC_TINYMQTTV1_ENABLE
            bool "Enable OCTinyMqttV1"
            help "This is a software implement, and use the v1 interface with dmp"
            select MQTT_AL_ENABLE
        config EC2XV1_ENABLE
	    bool "Enable EC2XV1"
            help "we use the EC2X as the ocmqtt protocol,support the v1 interface"
            select AT_ENABLE        
    endif
    
    if OC_MQTT_V5     
        config OC_TINYMQTTV5_ENABLE
            bool "Enable OCTinyMqttV5"
            help "This is a software implement, and use the v5 interface with dmp"
            select MQTT_AL_ENABLE
    endif            
       
                     
    config OCMQTT_NULL
        bool "we will create a new oc mqtt ourself"    
           
    endchoice
    
    rsource "./oc_mqtt_profile_v5/Kconfig"
        
    rsource "./oc_mqtt_profile/Kconfig"
                   
endif   
    
endmenu
```

## components/3rdparty/hwcloud_iot_link/iot_link/oc/oc_mqtt/oc_mqtt_profile/Kconfig
```kconfig
#
# Copyright (c) [2020] Huawei Technologies Co.,Ltd.All rights reserved.
#
# LiteOS NOVA is licensed under the Mulan PSL v1.
# You can use this software according to the terms and conditions of the Mulan PSL v1.
# You may obtain a copy of Mulan PSL v1 at:
#
#   http://license.coscl.org.cn/MulanPSL
#
# THIS SOFTWARE IS PROVIDED ON AN "AS IS" BASIS, WITHOUT WARRANTIES OF ANY KIND, EITHER
# EXPRESS OR IMPLIED, INCLUDING BUT NOT LIMITED TO NON-INFRINGEMENT, MERCHANTABILITY OR
# FIT FOR A PARTICULAR PURPOSE.
# See the Mulan PSL v1 for more details.
#

menu "OceanConnect MqttV1 Api"
visible if OC_MQTT_V1

config OC_MQTTV1_PROFILE
    bool  "use the v1 Api"
    default n
    
if OC_MQTTV1_PROFILE
    config OC_MQTTV1_DEMO
        bool "enable the v1 profile demo"
        default n
        select OCMQTT_DEMOENABLE
    if OC_MQTTV1_DEMO
        config OC_MQTTV1_DEMO_BS
            bool  "enable the v1 demo bs function"
            default n
    endif
        
endif
           
endmenu
```
