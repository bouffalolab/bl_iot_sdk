## components/3rdparty/hwcloud_iot_link/iot_link/oc/oc_mqtt/oc_mqtt_profile_v5/Kconfig
```kconfig
#
# Copyright (c) [2020] Huawei Technologies Co.,Ltd.All rights reserved.
#
# LiteOS NOVA is licensed under the Mulan PSL v1.
# You can use this software according to the terms and conditions of the Mulan PSL v1.
# You may obtain a copy of Mulan PSL v1 at:
#
#   http://license.coscl.org.cn/MulanPSL
#
# THIS SOFTWARE IS PROVIDED ON AN "AS IS" BASIS, WITHOUT WARRANTIES OF ANY KIND, EITHER
# EXPRESS OR IMPLIED, INCLUDING BUT NOT LIMITED TO NON-INFRINGEMENT, MERCHANTABILITY OR
# FIT FOR A PARTICULAR PURPOSE.
# See the Mulan PSL v1 for more details.
#

menu "OceanConnect MqttV5 Api"
visible if OC_MQTT_V5

config OC_MQTTV5_PROFILE
    bool  "Enable the v5  Api"
    default y
    
if OC_MQTTV5_PROFILE
    config OC_MQTTV5_DEMO
        bool "Enable the v5 Api demo"
        default n
        select OCMQTT_DEMOENABLE
    if OC_MQTTV5_DEMO
       config OC_MQTTV5_DEMO_TLS
            bool  "Enable the demo tls mode"
            default n
            select LINK_DTLS_ENABLE
       config OC_MQTTV5_DEMO_CYCLE
             int  "DEMO REPORT LOOP CYCLE(ms)"
             default 1000                  
    endif
     
endif   
           
endmenu
```

## components/3rdparty/hwcloud_iot_link/iot_link/os/Kconfig
```kconfig
#
# Copyright (c) [2020] Huawei Technologies Co.,Ltd.All rights reserved.
#
# LiteOS NOVA is licensed under the Mulan PSL v1.
# You can use this software according to the terms and conditions of the Mulan PSL v1.
# You may obtain a copy of Mulan PSL v1 at:
#
#   http://license.coscl.org.cn/MulanPSL
#
# THIS SOFTWARE IS PROVIDED ON AN "AS IS" BASIS, WITHOUT WARRANTIES OF ANY KIND, EITHER
# EXPRESS OR IMPLIED, INCLUDING BUT NOT LIMITED TO NON-INFRINGEMENT, MERCHANTABILITY OR
# FIT FOR A PARTICULAR PURPOSE.
# See the Mulan PSL v1 for more details.
#


menu "OS configuration"     
    choice
    prompt "please select one os;if you has your own, please select the os_new"
    
    config LITEOS_ENABLE
        bool "we use the liteos as the os kernel"
    
    config NOVAOS_ENABLE
        bool "we use the novaos as the os kernel"
    
    config LINUXOS_ENABLE
        bool "we use the linux as the os kernel"
        
    config MACOS_ENABLE
        bool "we use the macos as the os kernel"
    
    config NEW_OS
        bool "we use the new os as the os kernel"     
        
    endchoice 
             
endmenu
```

## components/3rdparty/hwcloud_iot_link/iot_link/shell/Kconfig
```kconfig
#
# Copyright (c) [2020] Huawei Technologies Co.,Ltd.All rights reserved.
#
# LiteOS NOVA is licensed under the Mulan PSL v1.
# You can use this software according to the terms and conditions of the Mulan PSL v1.
# You may obtain a copy of Mulan PSL v1 at:
#
#   http://license.coscl.org.cn/MulanPSL
#
# THIS SOFTWARE IS PROVIDED ON AN "AS IS" BASIS, WITHOUT WARRANTIES OF ANY KIND, EITHER
# EXPRESS OR IMPLIED, INCLUDING BUT NOT LIMITED TO NON-INFRINGEMENT, MERCHANTABILITY OR
# FIT FOR A PARTICULAR PURPOSE.
# See the Mulan PSL v1 for more details.
#
menu "Shell configuration"
    depends on LITEOS_ENABLE

config SHELL_ENABLE
    bool "Enable shell component"
    default n

if SHELL_ENABLE

    config SHELL_TASK_STACKSIZE
        int "The shell task size"
        default 2048  
        
    config SHELL_TASK_PRIOR
        int "The shell task priority"
        default 10     
endif

endmenu
```

## components/3rdparty/hwcloud_iot_link/iot_link/stimer/Kconfig
```kconfig
#
# Copyright (c) [2020] Huawei Technologies Co.,Ltd.All rights reserved.
#
# LiteOS NOVA is licensed under the Mulan PSL v1.
# You can use this software according to the terms and conditions of the Mulan PSL v1.
# You may obtain a copy of Mulan PSL v1 at:
#
#   http://license.coscl.org.cn/MulanPSL
#
# THIS SOFTWARE IS PROVIDED ON AN "AS IS" BASIS, WITHOUT WARRANTIES OF ANY KIND, EITHER
# EXPRESS OR IMPLIED, INCLUDING BUT NOT LIMITED TO NON-INFRINGEMENT, MERCHANTABILITY OR
# FIT FOR A PARTICULAR PURPOSE.
# See the Mulan PSL v1 for more details.
#


menu "Stimer configuration"

config STIMER_ENABLE
    bool "Enable IoT link software timer."
    default y
    
if STIMER_ENABLE
   config STIMER_STACKSIZE
        int  "stimer task stack size"
        default 2048
   
   config STIMER_TASKPRIOR
        int  "stimer task prior"
        default 10 
   
   config STIMER_DEMO_ENABLE
        bool "Enable stimer demo"
        default n
           
endif       
         
endmenu
```
